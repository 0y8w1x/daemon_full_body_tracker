## firmware/daemon_fbt_v1/boards/arm/daemon_fbt_dock_v1/Kconfig.board
```kconfig
# Copyright (c) 2024 Nordic Semiconductor ASA
# SPDX-License-Identifier: Apache-2.0

config BOARD_DAEMON_FBT_DOCK_V1
	bool "daemon_fbt_dock_v1"
	depends on SOC_NRF52820_QDAA
```

## firmware/daemon_fbt_v1/boards/arm/daemon_fbt_dock_v1/Kconfig.defconfig
```kconfig
# Copyright (c) 2024 Nordic Semiconductor ASA
# SPDX-License-Identifier: Apache-2.0

if BOARD_DAEMON_FBT_DOCK_V1

config BOARD
	default "daemon_fbt_dock_v1"

config BT_CTLR
   default BT


endif
```

## firmware/daemon_fbt_v1/boards/arm/daemon_fbt_nrf52805/Kconfig.board
```kconfig
# Copyright (c) 2024 Nordic Semiconductor ASA
# SPDX-License-Identifier: Apache-2.0

config BOARD_DAEMON_FBT_NRF52805
	bool "daemon_fbt_nrf52805"
	depends on SOC_NRF52805_CAAA
```

## firmware/daemon_fbt_v1/boards/arm/daemon_fbt_nrf52840/Kconfig.board
```kconfig
# Copyright (c) 2024 Nordic Semiconductor ASA
# SPDX-License-Identifier: Apache-2.0

config BOARD_DAEMON_FBT_NRF52840
	bool "daemon_fbt_nrf52840"
	depends on SOC_NRF52840_QFAA
```

## firmware/daemon_fbt_v1/boards/arm/daemon_fbt_nrf52840/Kconfig.defconfig
```kconfig
# Copyright (c) 2024 Nordic Semiconductor ASA
# SPDX-License-Identifier: Apache-2.0

if BOARD_DAEMON_FBT_NRF52840

config BOARD
	default "daemon_fbt_nrf52840"

config BT_CTLR
   default BT


endif
```

## firmware/daemon_fbt_v1/boards/arm/daemon_fbt_nrf52840_qiaa/Kconfig.board
```kconfig
# Copyright (c) 2024 Nordic Semiconductor ASA
# SPDX-License-Identifier: Apache-2.0

config BOARD_DAEMON_FBT_NRF52840_QIAA
	bool "daemon_fbt_nrf52840_qiaa"
	depends on SOC_NRF52840_QIAA
```

## firmware/daemon_fbt_v1/boards/arm/daemon_fbt_nrf52840_qiaa/Kconfig.defconfig
```kconfig
# Copyright (c) 2024 Nordic Semiconductor ASA
# SPDX-License-Identifier: Apache-2.0

if BOARD_DAEMON_FBT_NRF52840_QIAA

config BOARD
	default "daemon_fbt_nrf52840_qiaa"

config BT_CTLR
   default BT


endif
```
